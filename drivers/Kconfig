## drivers/Kconfig
```kconfig
menu "Device Drivers"

source "drivers/base/Kconfig"

source "drivers/connector/Kconfig"

source "drivers/mtd/Kconfig"

source "drivers/of/Kconfig"

source "drivers/parport/Kconfig"

source "drivers/pnp/Kconfig"

source "drivers/block/Kconfig"

# misc before ide - BLK_DEV_SGIIOC4 depends on SGI_IOC4

source "drivers/misc/Kconfig"

source "drivers/ide/Kconfig"

source "drivers/scsi/Kconfig"

source "drivers/ata/Kconfig"

source "drivers/md/Kconfig"

source "drivers/target/Kconfig"

source "drivers/message/fusion/Kconfig"

source "drivers/firewire/Kconfig"

source "drivers/message/i2o/Kconfig"

source "drivers/macintosh/Kconfig"

source "drivers/net/Kconfig"

source "drivers/isdn/Kconfig"

# input before char - char/joystick depends on it. As does USB.

source "drivers/input/Kconfig"

source "drivers/char/Kconfig"

source "drivers/i2c/Kconfig"

source "drivers/spi/Kconfig"

source "drivers/spmi/Kconfig"

source "drivers/slimbus/Kconfig"

source "drivers/hsi/Kconfig"

source "drivers/pps/Kconfig"

source "drivers/ptp/Kconfig"

source "drivers/pinctrl/Kconfig"

source "drivers/gpio/Kconfig"

source "drivers/w1/Kconfig"

source "drivers/power/Kconfig"

source "drivers/hwmon/Kconfig"

source "drivers/thermal/Kconfig"

source "drivers/watchdog/Kconfig"

source "drivers/ssb/Kconfig"

source "drivers/bcma/Kconfig"

source "drivers/mfd/Kconfig"

source "drivers/regulator/Kconfig"

source "drivers/media/Kconfig"

source "drivers/video/Kconfig"

source "sound/Kconfig"

source "drivers/hid/Kconfig"

source "drivers/usb/Kconfig"

source "drivers/uwb/Kconfig"

source "drivers/mmc/Kconfig"

source "drivers/memstick/Kconfig"

source "drivers/leds/Kconfig"

source "drivers/switch/Kconfig"

source "drivers/accessibility/Kconfig"

source "drivers/infiniband/Kconfig"

source "drivers/edac/Kconfig"

source "drivers/rtc/Kconfig"

source "drivers/dma/Kconfig"

source "drivers/dca/Kconfig"

source "drivers/auxdisplay/Kconfig"

source "drivers/uio/Kconfig"

source "drivers/vlynq/Kconfig"

source "drivers/virtio/Kconfig"

source "drivers/hv/Kconfig"

source "drivers/xen/Kconfig"

source "drivers/staging/Kconfig"

source "drivers/platform/Kconfig"

source "drivers/clk/Kconfig"

source "drivers/hwspinlock/Kconfig"

source "drivers/clocksource/Kconfig"

source "drivers/iommu/Kconfig"

source "drivers/remoteproc/Kconfig"

source "drivers/rpmsg/Kconfig"

source "drivers/virt/Kconfig"

source "drivers/devfreq/Kconfig"

source "drivers/gud/Kconfig"

source "drivers/coresight/Kconfig"

#/* FUJITSU:2012-11-19 recovery add start */
source "drivers/mmcdl/Kconfig"
#/* FUJITSU:2012-11-19 recovery add end */

#FUJITSU:DRIVER  add-s
source "drivers/fujitsu/Kconfig"
#FUJITSU:DRIVER  add-e

# FUJITSU:DRIVER 2012-12-20 Basic Feat EarphoneDriver start 
source "drivers/earphone/Kconfig"
# FUJITSU:DRIVER 2012-12-20 Basic Feat EarphoneDriver   end
#FUJITSU AUDIO: 2012-12-20 ADD-S
source "drivers/waveif/Kconfig"
#FUJITSU AUDIO: 2012-12-20 ADD-E
#FUJITSU AUDIO: 2012-12-20 Audio log driver ADD-S
source "drivers/audiolog/Kconfig"
#FUJITSU AUDIO: 2012-12-20 Audio log driver ADD-E

# FUJITSU:VIB DRIVER 2013-03-26 add-s
source "drivers/vibdrv/Kconfig"
# FUJITSU:VIB DRIVER 2013-03-26 add-e
# FUJITSU:VIB DRIVER 2012-12-20 add-s
source "drivers/tspdrv/Kconfig"
# FUJITSU:VIB DRIVER 2012-12-20 add-e

# FUJITSU:2013-01-15 FeliCa add-s
source "drivers/felica/Kconfig"
# FUJITSU:2013-01-15 FeliCa add-e
# FUJITSU:2013-01-31 MHL Start
source "drivers/mhl/sii8334drv/Kconfig"
# FUJITSU:2013-01-31 MHL End

# FUJITSU: 2013-01-31 CAMFWLIB add start
source "drivers/tmc112if/Kconfig"
# FUJITSU: 2013-01-31 CAMFWLIB add end
endmenu
```

## drivers/audiolog/Kconfig
```kconfig
menu "Fujitsu Audio Log System Driver"

config FUJITSU_AUDIOLOG
	tristate "Fujitsu Audio Log System Driver"
	default y
endmenu
```

## drivers/earphone/Kconfig
```kconfig
menu "Fujitsu Earphone Device Control support"

config FUJITSU_EDC
	tristate "Fujitsu Earphone Device Control Driver"
	default y
endmenu
```

## drivers/felica/Kconfig
```kconfig
config FELICA
	tristate "FeliCa chip GPIO port Driver"
	default y
	---help---
	  Say Y here if you want to enable felica chip GPIO port driver.

	  To compile this driver as a module, choose M here. The module will
	  be called felica_cen.

config FELICA_DEBUG
	tristate "FeliCa Driver Debug-mode"
	default y
	---help---
	  Say Y here if you want to enable FeliCa driver Debug-mode.
```

## drivers/fujitsu/Kconfig
```kconfig
menuconfig FUJITSU_DRV
	bool "Fujitsu drivers"
	default y

#/* FUJITSU:2012-12-25 IrDA_Driver add start */
config IRDA_FJ
	tristate "IrDA chip GPIO port Driver"
	default y
	---help---
	  Say Y here if you want to enable IrDA driver.
#/* FUJITSU:2012-12-25 IrDA_Driver add end */
```

## drivers/fujitsu/compass/Kconfig
```kconfig
config COMPASS
	tristate "Compass driver support"
	default y
	help
	  Say Y here to enable based compass support.
```

## drivers/fujitsu/ovp/Kconfig
```kconfig
config CONFIG_OVP_DEVICE_FUJITSU_OVP
	bool "Fujitsu OVP Devices driver"
	default y
	---help---
	  If you say yes here you get support for the   .
```

## drivers/mhl/sii8334drv/Kconfig
```kconfig
config SII8334_MHL_TX
    bool "Memory device driver"
    default y
    help
      The SII8334_MHL_TX driver
```

## drivers/mmcdl/Kconfig
```kconfig
#
# mmc dl configuration
#
config MMCDL
	tristate "MMC DL data read/write support"
```

## drivers/nonvolatile/Kconfig
```kconfig
#
# nonvolatile configuration
#
config NONVOLATILE
	tristate "Nonvolatile data read/write support"
```

## drivers/tmc112if/Kconfig
```kconfig
menu "Fujitsu tmc112if support"

config FUJITSU_TMC112IF
	tristate "Fujitsu tmc112if Interface Driver"
	default y
endmenu
```

## drivers/vibdrv/Kconfig
```kconfig
config VIBDRV
	tristate "vibrator driver support"
	default y
	help
	  Say Y here to enable based vibrator support.
```

## drivers/waveif/Kconfig
```kconfig
menu "Fujitsu WAVE-IF support"

config FUJITSU_WAVEIF
	tristate "Fujitsu WAVE Interface Driver"
	select VOIP_CLEARLY
	default y
config VOIP_CLEARLY
	bool
endmenu
```

## lib/crashdump/Kconfig
```kconfig
config CRASHDUMP_APP
	bool "Dump log when application crashes"
	default y

config CRASHDUMP
	bool "Dump log when crash occurs"
	default n
	depends on !KEXEC
	select FRAME_POINTER

	if CRASHDUMP
		config CRASHDUMP_BINDER_DIR
			string "Path of binder log"
			default "/sys/kernel/debug"
			help
				Specify the path where binder log is located.
				Possibilities are /proc, /debug, /sys/kernel/debug, /d.

		choice
			prompt "Where to dump"
			default CRASHDUMP_TO_FLASH

			config CRASHDUMP_TO_CONSOLE
				bool "Console"
				select DEBUG_LL
				help
					Say 'Y' if you wish to use console device.

			config CRASHDUMP_TO_FLASH
				bool "Flash"
				depends on MTD || RFS_FSR || BLOCK
				help
					Say 'Y' if you wish to use flash device.
		endchoice

		if CRASHDUMP_TO_FLASH
			choice
				prompt "Flash Type"
				default CRASHDUMP_TO_FLASH_BLKDEV

				config CRASHDUMP_TO_FLASH_MTD
					bool "MTD"
					depends on MTD
					help
						Say 'Y' if you wish to use MTD device.

				config CRASHDUMP_TO_FLASH_BML_BLKDEV
					bool "LinuStoreIII - use BML block device"
					depends on RFS_FSR
					help
						Say 'Y' if you wish to use BML block device.

				config CRASHDUMP_TO_FLASH_BML_BLKDEV_NUM
					string "LinuStoreIII - BML block device number"
					default "6"
					depends on CRASHDUMP_TO_FLASH_BML_BLKDEV
					help
						Specify LinuStoreIII - BML block device number.
						Specify "6" if you use "/dev/block/bml6". 

				config CRASHDUMP_TO_FLASH_BLKDEV
					bool "BLKDEV"
					depends on BLOCK
					help
						Say 'Y' if you wish to use block device.

				config CRASHDUMP_TO_FLASH_BLKDEV_PATH
					string "Full path of BLKDEV"
					default "/dev/block/mmcblk0p32"
					depends on CRASHDUMP_TO_FLASH_BLKDEV
					help
						Specify the full path of block device.
						Example "/dev/block/mmcblk0p32".
						!!!!!!!!!!!!!!!!!!!!!!!!!!!!!!!!!!!!!!!!!!!!
						This is currently unused.
						Block device named "crashdump" will be used instead.
						If you want to specify block device here,
						you have to comment out
						#define FINDBLKDEV_BYNAME
						in crashdump_write.c
						!!!!!!!!!!!!!!!!!!!!!!!!!!!!!!!!!!!!!!!!!!!!

			endchoice

			config CRASHDUMP_PART_NAME
				string "Partition Name for Crashdump"
				default "mmcblk0p32"
				help
					Specify the devicename of flash-device.
					Example for eMMC "mmcblk0p32".
					Example for NAND "kernellog".
			
		endif
	endif
```

## sound/soc/codecs/mc_yamaha/Kconfig
```kconfig
config SND_SOC_MC_YAMAHA
	tristate
	depends on SND_SOC && I2C
	select SND_HWDEP

config SND_SOC_MC_YAMAHA_DEBUG
	bool "MC_YAMAHA verbose debug messages while core driver call"
	select SND_DEBUG
	depends on SND_SOC_MC_YAMAHA
```
